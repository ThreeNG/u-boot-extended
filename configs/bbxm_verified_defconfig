## configs/bbxm_verified_defconfig
```kconfig
CONFIG_ARM=y
CONFIG_OMAP34XX=y
CONFIG_TARGET_OMAP3_BEAGLE=y
CONFIG_SPL=y
# CONFIG_CMD_IMLS is not set
# CONFIG_CMD_FLASH is not set
CONFIG_CMD_GPIO=y
CONFIG_SYS_NS16550=y
#CONFIG_VALIDATE=y
CONFIG_BEAGLEXM=y
# MLO is 54168/50248 bytes
#u-boot.img 315348  bytes
```
